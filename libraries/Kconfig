## libraries/Kconfig
```kconfig
config SOC_FAMILY_GD32
    bool
    help
        This SDK bundles trimmed GD32H77x_78x CMSIS and peripheral libraries.
        Project SConstruct files include them directly; keep the upstream
        GD32 ARM driver packages disabled when updating software packages.

config SOC_SERIES_GD32E50x
    bool
    select SOC_FAMILY_GD32

config SOC_SERIES_GD32F10x
    bool
    select ARCH_ARM_CORTEX_M3
    select SOC_FAMILY_GD32

config SOC_SERIES_GD32F20x
    bool
    select ARCH_ARM_CORTEX_M3
    select SOC_FAMILY_GD32

config SOC_SERIES_GD32F30x
    bool
    select ARCH_ARM_CORTEX_M4
    select SOC_FAMILY_GD32

config SOC_SERIES_GD32F4xx
    bool
    select ARCH_ARM_CORTEX_M4
    select SOC_FAMILY_GD32

config SOC_SERIES_GD32H7xx
    bool
    select ARCH_ARM_CORTEX_M7
    select SOC_FAMILY_GD32

config SOC_SERIES_GD32F5xx
    bool
    select ARCH_ARM_CORTEX_M33
    select SOC_FAMILY_GD32

config SOC_SERIES_GD32E23x
    bool
    select ARCH_ARM_CORTEX_M23
    select SOC_FAMILY_GD32
```
